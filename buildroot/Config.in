## buildroot/configs/gem5_defconfig
```kconfig
BR2_aarch64=y
BR2_JLEVEL=11
BR2_CCACHE=y
BR2_OPTIMIZE_3=y
BR2_TOOLCHAIN_BUILDROOT_GLIBC=y
BR2_KERNEL_HEADERS_5_15=y
BR2_PACKAGE_GLIBC_UTILS=y
BR2_TOOLCHAIN_BUILDROOT_CXX=y
BR2_GCC_ENABLE_LTO=y
BR2_PACKAGE_HOST_GDB=y
# BR2_TARGET_ENABLE_ROOT_LOGIN is not set
BR2_ROOTFS_OVERLAY="$(BR2_EXTERNAL_DPDK_GEM5_PATH)/overlay"
BR2_LINUX_KERNEL=y
BR2_LINUX_KERNEL_USE_CUSTOM_CONFIG=y
BR2_LINUX_KERNEL_CUSTOM_CONFIG_FILE="$(BR2_EXTERNAL_DPDK_GEM5_PATH)/linux.config"
BR2_LINUX_KERNEL_VMLINUX=y
BR2_PACKAGE_LINUX_TOOLS_IIO=y
BR2_PACKAGE_LINUX_TOOLS_PCI=y
BR2_PACKAGE_PCIUTILS=y
BR2_PACKAGE_PYTHON3=y
BR2_PACKAGE_IPERF3=y
BR2_PACKAGE_IPUTILS=y
BR2_TARGET_ROOTFS_EXT2=y
BR2_TARGET_ROOTFS_EXT2_SIZE="1000M"
```
